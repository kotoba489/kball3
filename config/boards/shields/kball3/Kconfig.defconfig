## config/boards/shields/kball3/Kconfig.defconfig
```kconfig
if SHIELD_KBALL3

config ZMK_KEYBOARD_NAME
    default "kball3"

config BT
    default y

config ZMK_BLE
    default y

config ZMK_POINTING
    default y

config PAW3222
    default y

endif
```
